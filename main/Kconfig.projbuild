## main/Kconfig.projbuild
```kconfig
menu "ESP Wakeup Keypress"

    config ESP_WAKEUP_KEYPRESS_WIFI_SSID
        depends on !EXAMPLE_WIFI_SSID_PWD_FROM_STDIN
        string "WiFi SSID"
        default "Not My Wifi"
        help
            SSID (network name) to connect to.

    config ESP_WAKEUP_KEYPRESS_WIFI_PASSWORD
        string "Wi-Fi Password"
        default "imiplacsarmalele"
        help
            Wi-Fi password to use.
            Can be left blank if the network has no security set.

    config ESP_WAKEUP_KEYPRESS_HTTPD_PASSWORD
        string "HTTPD password"
        default "wakeup"
        help
            Password for HTTP server authentication in the query URL.

    config ESP_WAKEUP_KEYPRESS_LED_STRIP_GPIO_NUM
        int "LED strip GPIO num"
        default 38
        help
            GPIO number of RMT LED strip on the devboard

    config ESP_WAKEUP_KEYPRESS_RESET_GPIO_ENABLED
        bool "Enable hardware reset pin"
        default n
        help
            Enable hardware reset pin for PC restart functionality.

    config ESP_WAKEUP_KEYPRESS_RESET_GPIO_NUM
        depends on ESP_WAKEUP_KEYPRESS_RESET_GPIO_ENABLED
        int "PC Reset pin GPIO num"
        default 1
        help
            GPIO number connected to PC reset pins on motherboard.

endmenu
```
